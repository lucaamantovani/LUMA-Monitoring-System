#include <Adafruit_GFX.h>
#include <Adafruit_SSD1306.h>
#include <Wire.h>
#include <ArduinoBLE.h>

#define DISPLAY_Address 0x3C
#define UpperThreshold 650
#define LowerThreshold 530

// 'LUMA_LOGO', 128x64px
const unsigned char Luma_Logo [] PROGMEM = {
  0x00, 0x00, 0x00, 0x00, 0x00, 0x00, 0x00, 0x00, 0x00, 0x00, 0x00, 0x00, 0x00, 0x00, 0x00, 0x00, 
  0x00, 0x00, 0x00, 0x00, 0x00, 0x00, 0x00, 0x00, 0x00, 0x00, 0x00, 0x00, 0x00, 0x00, 0x00, 0x00, 
  0x00, 0x00, 0x00, 0x00, 0x00, 0x00, 0x00, 0x00, 0x00, 0x00, 0x00, 0x00, 0x00, 0x00, 0x00, 0x00, 
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  0x00, 0x00, 0x00, 0x00, 0x00, 0x00, 0x00, 0x00, 0x00, 0x00, 0x00, 0x00, 0x00, 0x00, 0x00, 0x00
};

const unsigned char Warning [] PROGMEM = {
  0x00, 0x00, 0x00, 0x00, 0x00, 0x00, 0x00, 0x00, 0x00, 0x00, 0x00, 0x00, 0x00, 0x00, 0x00, 0x00, 
  0x00, 0x00, 0x00, 0x00, 0x00, 0x00, 0x00, 0x00, 0x00, 0x00, 0x00, 0x00, 0x00, 0x00, 0x00, 0x00, 
  0x00, 0x00, 0x00, 0x00, 0x00, 0x00, 0x00, 0x00, 0x00, 0x00, 0x00, 0x00, 0x00, 0x00, 0x00, 0x00, 
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  0x00, 0x00, 0x00, 0x00, 0x00, 0x00, 0x00, 0x00, 0x00, 0x00, 0x00, 0x00, 0x00, 0x00, 0x00, 0x00
};

const unsigned char BLE_enabled [] PROGMEM = {
  0x00, 0x00, 0x00, 0x00, 0x00, 0x00, 0x00, 0x00, 0x00, 0x00, 0x00, 0x00, 0x00, 0x00, 0x00, 0x00, 
  0x00, 0x00, 0x00, 0x00, 0x00, 0x00, 0x00, 0x00, 0x00, 0x00, 0x00, 0x00, 0x00, 0x00, 0x00, 0x00, 
  0x00, 0x00, 0x00, 0x00, 0x00, 0x00, 0x00, 0x00, 0x00, 0x00, 0x00, 0x00, 0x00, 0x00, 0x00, 0x00, 
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  0x00, 0x00, 0x00, 0x00, 0x00, 0x00, 0x00, 0x00, 0x00, 0x00, 0x00, 0x00, 0x00, 0x00, 0x00, 0x00
};

const unsigned char BLE_connected [] PROGMEM = {
  0x00, 0x00, 0x00, 0x00, 0x00, 0x00, 0x00, 0x00, 0x00, 0x00, 0x00, 0x00, 0x00, 0x00, 0x00, 0x00, 
  0x00, 0x00, 0x00, 0x00, 0x00, 0x00, 0x00, 0x00, 0x00, 0x00, 0x00, 0x00, 0x00, 0x00, 0x00, 0x00, 
  0x00, 0x00, 0x00, 0x00, 0x00, 0x00, 0x00, 0x00, 0x00, 0x00, 0x00, 0x00, 0x00, 0x00, 0x00, 0x00, 
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  0x00, 0x00, 0x00, 0x00, 0x00, 0x00, 0x00, 0x00, 0x00, 0x00, 0x00, 0x00, 0x00, 0x00, 0x00, 0x00
};

BLEService ecgService("57a806f7-ab55-4932-ada2-5f2c5a94b3f7"); // Create service
BLEByteCharacteristic ecgCharacteristic("57a806f7-ab55-4932-ada2-5f2c5a94b3f7", BLERead);

Adafruit_SSD1306 display(128, 64);

int a=0;

int lasta=0;
int lastb=0;

int LastTime=0;
int ThisTime;

int BPM=0;

bool BPMTiming=false;
bool BeatComplete=false;

void setup() {

  Serial.begin(9600);

  display.begin(SSD1306_SWITCHCAPVCC, DISPLAY_Address);
  display.clearDisplay(); //for Clearing the display
  display.drawBitmap(0, 0, Luma_Logo, 128, 64, WHITE); // display.drawBitmap(x position, y position, bitmap data, bitmap width, bitmap height, color)
  display.display();

  pinMode(9, INPUT); //for L0+
  pinMode(8, INPUT); //for L0-

  pinMode(4, OUTPUT);
  pinMode(3, OUTPUT);

  Serial.print("BLE Initialization...");
  if (!BLE.begin()) {
    Serial.println("FAILED!");
    for(;;);
  }else{
    Serial.println("SUCCESS!");
  }

  // set the local name peripheral advertises
  BLE.setLocalName("LUMA Monitoring System");
  
  // set the UUID for the service this peripheral advertises
  BLE.setAdvertisedService(ecgService);

  // add the characteristic to the service
  ecgService.addCharacteristic(ecgCharacteristic);

  // add service
  BLE.addService(ecgService);

  // initial value
  ecgCharacteristic.setValue(0);

  BLE.advertise();

  Serial.println(("Bluetooth device active, waiting for connections..."));

  delay(2000);
  display.clearDisplay(); //for Clearing the display
  display.drawBitmap(0, 0, BLE_enabled, 128, 64, WHITE); // display.drawBitmap(x position, y position, bitmap data, bitmap width, bitmap height, color)
  display.display();

}

void loop() {

  BLEDevice central = BLE.central();
  
  if (central) {
    
    display.clearDisplay(); //for Clearing the display
    display.drawBitmap(0, 0, BLE_connected, 128, 64, WHITE); // display.drawBitmap(x position, y position, bitmap data, bitmap width, bitmap height, color)
    display.display();
    
    Serial.print("Connected to central: ");
    
    // print the central's BT address:
    Serial.println(central.address());
    
    // turn on the LED to indicate the connection:
    digitalWrite(LED_BUILTIN, HIGH);

    display.clearDisplay();
    
    while (central.connected()) {
 
      int value = 0;
    
      if ((digitalRead(8) == 1) || (digitalRead(9) == 1)){     
        
        //Serial.println("NaN");
        
      } else {
        
        if(a > 127)
        {  
          display.clearDisplay();
          a = 0;
          lasta = a; 
        }
     
        ThisTime = millis();
        int value = analogRead(0);
        display.setTextColor(WHITE);
        int b = 60-(value/16);
        display.writeLine(lasta,lastb,a,b,WHITE);
        lastb = b;
        lasta = a;
        
        if (value>UpperThreshold) {
          
          if (BeatComplete)
          {  
            BPM=ThisTime-LastTime;
            BPM=int(60/(float(BPM)/1000));
            BPMTiming=false;
            BeatComplete=false;
            tone(8,1000,250);
          }
          if(BPMTiming==false)
          {
            LastTime=millis();
            BPMTiming=true;
          }
          
        }
        
        if ((value<LowerThreshold)&(BPMTiming)) 
          BeatComplete=true;

        if(BPM>100 || BPM<45){
          digitalWrite(3, HIGH);
          digitalWrite(4, LOW);
        }else{ 
          digitalWrite(4, HIGH);
          digitalWrite(3, LOW); 
        }
        ecgCharacteristic.writeValue(BPM);
       
        display.writeFillRect(0,50,128,16,BLACK);
        display.setCursor(0,50);
        display.print("BPM:");
        display.print(BPM);
        display.setCursor(50,50);
        display.print("LUMA IoT MS");
        display.display();
        
        a++;
        //Serial.println(analogRead(A0));
      }
      delay(1);  
    }
    digitalWrite(4, LOW);
    digitalWrite(3, LOW);
    display.clearDisplay(); //for Clearing the display
    display.drawBitmap(0, 0, Warning, 128, 64, WHITE);
    display.display();
    
    digitalWrite(LED_BUILTIN, LOW);
    Serial.print("Disconnected from central: ");
    Serial.println(central.address());
  
  }
  
}
